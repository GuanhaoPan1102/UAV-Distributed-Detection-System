## Data_Collection_Phase/Firmware_Logger_RC_autoMapping/sdkconfig.defaults
```kconfig
# ==========================================
# Firmware_Logger (Data Collection Phase)
# 職責: ESP-NOW 接收、Terminal 視覺化監控
# ==========================================

# 1. 儲存與核心效能解放
CONFIG_ESPTOOLPY_FLASHSIZE_4MB=y
CONFIG_ESPTOOLPY_FLASHSIZE="4MB"
CONFIG_ESP_DEFAULT_CPU_FREQ_MHZ_240=y
CONFIG_ESP_DEFAULT_CPU_FREQ_MHZ=240
CONFIG_ESPTOOLPY_FLASHMODE_QIO=y
CONFIG_ESPTOOLPY_FLASHMODE="qio"
CONFIG_ESPTOOLPY_FLASHFREQ_80M=y
CONFIG_ESPTOOLPY_FLASHFREQ="80m"

# 2. 關閉藍牙 (純使用 Wi-Fi 底層的 ESP-NOW)
CONFIG_BT_ENABLED=n

# 3. SD 卡檔案系統支援 (必須開啟長檔名，否則無法建立帶有 MAC 資訊的 CSV 檔案)
CONFIG_FATFS_LFN_HEAP=y

# 4. RTOS 效能 (標準頻率 100Hz 已足夠)
CONFIG_FREERTOS_HZ=100
```

## Data_Collection_Phase/Firmware_SlaveTTGO/sdkconfig.defaults
```kconfig
# ==========================================
# Firmware_Slave (Data Collection Phase)
# 職責: UART 接收、GPS 時間還原、SD卡存檔、ESP-NOW 通報
# ==========================================

# 1. 儲存與核心效能解放
CONFIG_ESPTOOLPY_FLASHSIZE_4MB=y
CONFIG_ESPTOOLPY_FLASHSIZE="4MB"
CONFIG_ESP_DEFAULT_CPU_FREQ_MHZ_240=y
CONFIG_ESP_DEFAULT_CPU_FREQ_MHZ=240
CONFIG_ESPTOOLPY_FLASHMODE_QIO=y
CONFIG_ESPTOOLPY_FLASHMODE="qio"
CONFIG_ESPTOOLPY_FLASHFREQ_80M=y
CONFIG_ESPTOOLPY_FLASHFREQ="80m"

# 2. 關閉藍牙 (純使用 Wi-Fi 底層的 ESP-NOW，釋放大量 SRAM 給 SD 卡緩衝)
CONFIG_BT_ENABLED=n

# 3. SD 卡檔案系統支援 (必須開啟長檔名，否則無法建立帶有 MAC 資訊的 CSV 檔案)
CONFIG_FATFS_LFN_HEAP=y

# 4. RTOS 效能 (1000Hz，確保能及時清空來自 Scanner 的 UART 爆發接收緩衝區)
CONFIG_FREERTOS_HZ=1000
```

## Data_Collection_Phase/Firmware_UAV/sdkconfig.defaults
```kconfig
# ==========================================
# Firmware_UAV (Data Collection Phase)
# 職責: GPS 解析與 BLE 廣播
# ==========================================

# 1. 儲存與核心效能解放
CONFIG_ESPTOOLPY_FLASHSIZE_4MB=y
CONFIG_ESPTOOLPY_FLASHSIZE="4MB"
CONFIG_ESP_DEFAULT_CPU_FREQ_MHZ_240=y
CONFIG_ESP_DEFAULT_CPU_FREQ_MHZ=240
CONFIG_ESPTOOLPY_FLASHMODE_QIO=y
CONFIG_ESPTOOLPY_FLASHMODE="qio"
CONFIG_ESPTOOLPY_FLASHFREQ_80M=y
CONFIG_ESPTOOLPY_FLASHFREQ="80m"

# 2. 藍牙設定 (純 BLE 模式，節省記憶體)
CONFIG_BT_ENABLED=y
CONFIG_BTDM_CTRL_MODE_BLE_ONLY=y
CONFIG_BTDM_CTRL_MODE_BR_EDR_ONLY=n
CONFIG_BTDM_CTRL_MODE_BTDM=n

# 3. RTOS 效能
CONFIG_FREERTOS_HZ=100
```
